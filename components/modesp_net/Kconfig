## components/modesp_net/Kconfig
```kconfig
menu "ModESP Network"

    config MODESP_NET_ENABLE
        bool "Enable networking (WiFi + HTTP + WebSocket)"
        default y
        help
            Master switch for the modesp_net component. When disabled, the
            component compiles empty (zero sources) and main.cpp skips the
            WiFi/HTTP/WebSocket wiring — for offline or BLE-only products.

            Disabling networking also removes OTA-over-HTTP; the OTA rollback
            watchdog then validates the firmware right after the main loop
            starts (no network health check available).

            Cloud backends (MQTT) require this option.

    config MODESP_NET_SET_DEFAULT_NETIF
        bool "Make the STA netif the default route after start"
        depends on MODESP_NET_ENABLE
        default y if IDF_TARGET_ESP32P4
        default n
        help
            Call esp_netif_set_default_netif() on the station interface right
            after esp_wifi_start(). Needed when Wi-Fi runs on a co-processor
            (ESP-Hosted / esp_wifi_remote): unbound UDP sockets such as SNTP may
            otherwise not leave through the hosted interface. Harmless on
            targets with native Wi-Fi.

    config MODESP_WIFI_RESTART_ON_LONG_DISCONNECT
        bool "Restart after 10 minutes without Wi-Fi in total"
        depends on MODESP_NET_ENABLE
        default y
        help
            In station mode, the time without a connection is added up, and an
            hour connected without a break clears it; at 10 minutes the device
            restarts. Meant for a radio that stopped answering. A router that
            drops for half a minute now and then reaches it in a few hours, and
            the restart then cuts whatever the device was doing. With Wi-Fi on
            an ESP-Hosted co-processor, ESP-Hosted itself restarts the host
            when the co-processor stops answering on the bus
            (ESP_HOSTED_HOST_TRANSPORT_RESTART_ON_FAILURE), and this is not
            needed.

    config MODESP_HTTP_FRAMEWORK_ROUTES
        bool "ModESP framework routes: board, devices, modules, journal, bus scanners"
        depends on MODESP_NET_ENABLE
        default y
        help
            GET /api/board, GET/POST /api/devices, GET /api/modules, GET /api/log
            and /api/log/summary, and the OneWire and BLE scanners
            (/api/onewire/scan, /api/drivers/scan, /api/ble/scan). A product with
            no device registry, no journal source and no bus discovery turns them
            off: it keeps their eight handler slots and the devices routes' two
            4 KB static buffers.

    config MODESP_HTTPD_MAX_OPEN_SOCKETS
        int "HTTP server sessions, WebSocket and HTTP together"
        depends on MODESP_NET_ENABLE
        range 1 58
        default 4
        help
            httpd's max_open_sockets. A WebSocket client holds its session for as
            long as it stays connected (WsService serves up to 3), so HTTP gets
            what is left. With every session taken, httpd closes the one least
            recently heard from to admit a new connection, and a WebSocket that
            only listens is heard from once per heartbeat (its PONG). A browser
            loading a page through too few sessions closes live WebSockets.

            httpd keeps 3 sockets of its own on top of these, and all of it has
            to fit in LWIP_MAX_SOCKETS with every other socket the firmware
            opens; http_service.cpp refuses to build if this plus 3 does not.

endmenu
```

## modules/audio/Kconfig
```kconfig
menu "Audio core (modules/audio)"

    config AUDIO_LINE_IN_FITTED
        bool "A line-in ADC is fitted on the main I2S port"
        default n
        help
            The board profile wires the main port's data-in (boards/p4_player/board.json,
            i2s_a din) for two things: the PCM1808 line input of the design (docs/CONCEPT.md),
            and, since link protocol 1.9, the Bluetooth link, which the panel clocks and
            receives through that same port. A wired data-in is therefore no proof that an
            ADC is there, and the unit this firmware runs on has none.
            Off, AUX is not offered and a request for it is refused: offered, picking it
            switched the amplifier on to play a floating input. Turn it on for a unit that
            has the ADC.

endmenu
```
